## configs/qcm6490_tachyon_defconfig
```kconfig
# Configuration for building U-Boot to be flashed
# to the uefi partition of QCM6490 dev boards with
# the "Linux Embedded" partition layout (which have
# a dedicated "uefi" partition for edk2/U-Boot)

#include "qcm6490_defconfig"

CONFIG_SYS_VENDOR="particle"
CONFIG_SYS_BOARD="tachyon"
CONFIG_SYS_CONFIG_NAME="qcom"

CONFIG_DEFAULT_DEVICE_TREE="qcom/qcm6490-tachyon"

CONFIG_SYS_MALLOC_F=y
CONFIG_SYS_MALLOC_F_LEN=0x20000
CONFIG_MSM_SMEM=y
CONFIG_ARCH_FIXUP_FDT_MEMORY=y
CONFIG_BOARD_EARLY_INIT_F=y
CONFIG_DM_DEVICE_REMOVE=y
```
